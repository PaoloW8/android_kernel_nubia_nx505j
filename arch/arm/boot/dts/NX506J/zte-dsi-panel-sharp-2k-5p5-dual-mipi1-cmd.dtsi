/* Copyright (c) 2013, The Linux Foundation. All rights reserved.
 *
 * This program is free software; you can redistribute it and/or modify
 * it under the terms of the GNU General Public License version 2 and
 * only version 2 as published by the Free Software Foundation.
 *
 * This program is distributed in the hope that it will be useful,
 * but WITHOUT ANY WARRANTY; without even the implied warranty of
 * MERCHANTABILITY or FITNESS FOR A PARTICULAR PURPOSE.  See the
 * GNU General Public License for more details.
 */

/*---------------------------------------------------------------------------
 * This file is autogenerated file using gcdb parser. Please do not edit it.
 * Update input XML file to add a new entry or update variable in this file
 * VERSION = "1.0"
 *---------------------------------------------------------------------------*/
&mdss_mdp {
	dsi_sp_2k_5p5_1: qcom,mdss_dsi_sharp_2k_5p5_dualmipi1_cmd {
		qcom,mdss-dsi-panel-name = "Dual 1 sharp 2k 5p5 cmd mode dsi panel";
		qcom,mdss-dsi-panel-controller = <&mdss_dsi1>;
		qcom,mdss-dsi-panel-type = "dsi_cmd_mode";
		qcom,mdss-dsi-panel-destination = "display_2";
		qcom,mdss-dsi-panel-framerate = <60>;
		qcom,mdss-dsi-virtual-channel-id = <0>;
		qcom,mdss-dsi-stream = <0>;
		qcom,mdss-dsi-panel-width = <720>;
		qcom,mdss-dsi-panel-height = <2560>;
		qcom,mdss-dsi-h-front-porch = <100>;
		qcom,mdss-dsi-h-back-porch = <44>;
		qcom,mdss-dsi-h-pulse-width = <4>;
		qcom,mdss-dsi-h-sync-skew = <0>;
		qcom,mdss-dsi-v-back-porch = <3>;
		qcom,mdss-dsi-v-front-porch = <4>;
		qcom,mdss-dsi-v-pulse-width = <1>;
		qcom,mdss-dsi-h-left-border = <0>;
		qcom,mdss-dsi-h-right-border = <0>;
		qcom,mdss-dsi-v-top-border = <0>;
		qcom,mdss-dsi-v-bottom-border = <0>;
		qcom,mdss-dsi-bpp = <24>;
		qcom,mdss-dsi-color-order = "rgb_swap_rgb";
		qcom,mdss-dsi-underflow-color = <0xff>;
		qcom,mdss-dsi-border-color = <0>;
		qcom,mdss-dsi-te-pin-select = <1>;
		qcom,mdss-dsi-te-dcs-command = <1>;
		qcom,mdss-dsi-te-check-enable;
		qcom,mdss-dsi-te-using-te-pin;
		qcom,mdss-dsi-on-command = [
					29 01 00 00 00 00 02 b0 00
					29 01 00 00 00 00 02 d6 01
					29 01 00 00 00 00 02 b3 08
					29 01 00 00 00 00 08 b8 3f 51 00 00 00 00 00
					29 01 00 00 00 00 1a ce 55 40 49 53 59 5e 63
					68 6e 74 7e 8a 98 a8 bb d0 ff 04 19 04 04 00 00 69 5a
					39 01 00 00 00 00 02 35 00
					39 01 00 00 00 00 05 2a 00 00 05 9f
					];
		qcom,mdss-dsi-on-second_command = [
					39 01 00 00 00 00 02 55 00
					39 01 00 00 00 00 02 53 24
					39 01 00 00 00 00 02 29 00
					39 01 00 00 64 00 02 11 00
					];
		qcom,mdss-dsi-off-command = [
					39 01 00 00 10 00 02 28 00
					39 01 00 00 40 00 02 10 00];
		qcom,mdss-dsi-on-command-state = "dsi_lp_mode";
		qcom,mdss-dsi-off-command-state = "dsi_hs_mode";
		qcom,mdss-dsi-h-sync-pulse = <0>;
		qcom,mdss-dsi-lane-map = "lane_map_0123";
		qcom,mdss-dsi-bllp-power-mode;
		qcom,mdss-dsi-bllp-eof-power-mode;
		qcom,mdss-dsi-traffic-mode = "burst_mode";
		qcom,mdss-dsi-panel-broadcast-mode;
		qcom,mdss-dsi-lane-0-state;
		qcom,mdss-dsi-lane-1-state;
		qcom,mdss-dsi-lane-2-state;
		qcom,mdss-dsi-lane-3-state;
		qcom,mdss-dsi-panel-timings = [d5 32 22 00 ff 64 26 36 29 03 04 00];
		qcom,mdss-dsi-t-clk-post = <0x03>;
		qcom,mdss-dsi-t-clk-pre = <0x28>;
		qcom,mdss-brightness-max-level = <255>;
		qcom,mdss-dsi-bl-min-level = <6>;
		qcom,mdss-dsi-bl-max-level = <215>;
		qcom,mdss-dsi-bright-to-bl-lvl-para-a1 = <88>;
		qcom,mdss-dsi-bright-to-bl-lvl-para-a2 = <90>;
		qcom,mdss-dsi-bright-to-bl-lvl-para-b1 = <4294966588>;
		qcom,mdss-dsi-bright-to-bl-lvl-para-b2 = <4294965883>;
		qcom,mdss-dsi-bright-to-bl-lvl-turn-point = <186>;
		qcom,mdss-dsi-dma-trigger = "trigger_sw";
		qcom,mdss-dsi-mdp-trigger = "none";
		qcom,mdss-dsi-bl-pmic-control-type = "bl_ctrl_dcs";
		qcom,mdss-dsi-bl-pmic-control-reg  = <0x51>;
		qcom,mdss-dsi-reset-sequence = <1 10>;
	};
};
