/* Copyright (c) 2013, The Linux Foundation. All rights reserved.
 *
 * This program is free software; you can redistribute it and/or modify
 * it under the terms of the GNU General Public License version 2 and
 * only version 2 as published by the Free Software Foundation.
 *
 * This program is distributed in the hope that it will be useful,
 * but WITHOUT ANY WARRANTY; without even the implied warranty of
 * MERCHANTABILITY or FITNESS FOR A PARTICULAR PURPOSE.  See the
 * GNU General Public License for more details.
 */

/*---------------------------------------------------------------------------
 * This file is autogenerated file using gcdb parser. Please do not edit it.
 * Update input XML file to add a new entry or update variable in this file
 * VERSION = "1.0"
 *---------------------------------------------------------------------------*/
&mdss_mdp {
	dsi_sp_1080_6p4_vid: qcom,mdss_dsi_sharp_1080p_6p4_video {
		qcom,mdss-dsi-panel-name = "sharp 1080p 6p4 video mode dsi panel";
		qcom,mdss-dsi-panel-controller = <&mdss_dsi0>;
		qcom,mdss-dsi-panel-type = "dsi_video_mode";
		qcom,mdss-dsi-panel-destination = "display_1";
		qcom,mdss-dsi-panel-framerate = <60>;
		qcom,mdss-dsi-virtual-channel-id = <0>;
		qcom,mdss-dsi-stream = <0>;
		qcom,mdss-dsi-panel-width = <1080>;
		qcom,mdss-dsi-panel-height = <1920>;
		qcom,mdss-dsi-h-front-porch = <100>;
		qcom,mdss-dsi-h-back-porch = <48>;
		qcom,mdss-dsi-h-pulse-width = <12>;
		qcom,mdss-dsi-h-sync-skew = <0>;
		qcom,mdss-dsi-v-back-porch = <4>;
		qcom,mdss-dsi-v-front-porch = <4>;
		qcom,mdss-dsi-v-pulse-width = <2>;
		qcom,mdss-dsi-h-left-border = <0>;
		qcom,mdss-dsi-h-right-border = <0>;
		qcom,mdss-dsi-v-top-border = <0>;
		qcom,mdss-dsi-v-bottom-border = <0>;
		qcom,mdss-dsi-bpp = <24>;
		qcom,mdss-dsi-underflow-color = <0xff>;
		qcom,mdss-dsi-border-color = <0>;
		qcom,mdss-dsi-on-command = [
					23 01 00 00 00 00 02 b0 04
					05 01 00 00 00 00 02 00 00
					05 01 00 00 00 00 02 00 00
					23 01 00 00 00 00 02 d6 01
					29 01 00 00 00 00 08 ce 00 01 88 c1 00 1e 04
					];
		qcom,mdss-dsi-on-second_command = [
					39 01 00 00 00 00 02 55 01
					39 01 00 00 00 00 02 53 2c
					39 01 00 00 00 00 02 29 00
					39 01 00 00 96 00 02 11 00
					];
		qcom,mdss-dsi-off-command = [
					39 01 00 00 20 00 02 28 00
					39 01 00 00 78 00 02 10 00];
		qcom,mdss-dsi-on-command-state = "dsi_lp_mode";
		qcom,mdss-dsi-off-command-state = "dsi_hs_mode";
		qcom,mdss-dsi-h-sync-pulse = <0>;
		qcom,mdss-dsi-traffic-mode = "burst_mode";
		qcom,mdss-dsi-bllp-eof-power-mode;
		qcom,mdss-dsi-bllp-power-mode;
		qcom,mdss-dsi-lane-0-state;
		qcom,mdss-dsi-lane-1-state;
		qcom,mdss-dsi-lane-2-state;
		qcom,mdss-dsi-lane-3-state;
		qcom,mdss-dsi-panel-timings = [cf 41 38 00 5e 51 3a 43 59 03 04 00];
		qcom,mdss-dsi-t-clk-post = <0x04>;
		qcom,mdss-dsi-t-clk-pre = <0x1C>;
		qcom,mdss-brightness-max-level = <255>;
		qcom,mdss-dsi-bl-min-level = <177>;
		qcom,mdss-dsi-bl-max-level = <4095>;
		qcom,mdss-dsi-bright-to-bl-lvl-para-a1 = <1635>;
		qcom,mdss-dsi-bright-to-bl-lvl-para-a2 = <1388>;
		qcom,mdss-dsi-bright-to-bl-lvl-para-b1 = <160>;
		qcom,mdss-dsi-bright-to-bl-lvl-para-b2 = <55457>;
		qcom,mdss-dsi-bright-to-bl-lvl-turn-point = <186>;
		mdss-dsi-hfp-power-mode;
		mdss-dsi-hsa-power-mode;
		mdss-dsi-hbp-power-mode;
		mdss-dsi-bllp-power-mode;
		mdss-dsi-bllp-eof-power-mode;
		qcom,mdss-dsi-dma-trigger = "trigger_sw";
		qcom,mdss-dsi-mdp-trigger = "none";
		qcom,mdss-dsi-bl-pmic-control-type = "bl_ctrl_wled";
		qcom,mdss-dsi-reset-sequence = <0 50>, <1 10>;
	};
};
