/* Copyright (c) 2013, The Linux Foundation. All rights reserved.
 *
 * This program is free software; you can redistribute it and/or modify
 * it under the terms of the GNU General Public License version 2 and
 * only version 2 as published by the Free Software Foundation.
 *
 * This program is distributed in the hope that it will be useful,
 * but WITHOUT ANY WARRANTY; without even the implied warranty of
 * MERCHANTABILITY or FITNESS FOR A PARTICULAR PURPOSE.  See the
 * GNU General Public License for more details.
 */

/*---------------------------------------------------------------------------
 * This file is autogenerated file using gcdb parser. Please do not edit it.
 * Update input XML file to add a new entry or update variable in this file
 * VERSION = "1.0"
 *---------------------------------------------------------------------------*/
&mdss_mdp {
	dsi_sp_1080_5p5_vid: qcom,mdss_dsi_sharp_1080p_5p5_video {
		qcom,mdss-dsi-panel-name = "sharp 1080p 5p5 video mode dsi panel";
		qcom,mdss-dsi-panel-controller = <&mdss_dsi0>;
		qcom,mdss-dsi-panel-type = "dsi_video_mode";
		qcom,mdss-dsi-panel-destination = "display_1";
		qcom,mdss-dsi-panel-framerate = <60>;
		qcom,mdss-dsi-virtual-channel-id = <0>;
		qcom,mdss-dsi-stream = <0>;
		qcom,mdss-dsi-panel-width = <1080>;
		qcom,mdss-dsi-panel-height = <1920>;
		qcom,mdss-dsi-h-front-porch = <100>;
		qcom,mdss-dsi-h-back-porch = <48>;
		qcom,mdss-dsi-h-pulse-width = <12>;
		qcom,mdss-dsi-h-sync-skew = <0>;
		qcom,mdss-dsi-v-back-porch = <4>;
		qcom,mdss-dsi-v-front-porch = <4>;
		qcom,mdss-dsi-v-pulse-width = <2>;
		qcom,mdss-dsi-h-left-border = <0>;
		qcom,mdss-dsi-h-right-border = <0>;
		qcom,mdss-dsi-v-top-border = <0>;
		qcom,mdss-dsi-v-bottom-border = <0>;
		qcom,mdss-dsi-bpp = <24>;
		qcom,mdss-dsi-underflow-color = <0xff>;
		qcom,mdss-dsi-border-color = <0>;
		qcom,mdss-dsi-on-command = [23 01 00 00 00 00 02 b0 04
					05 01 00 00 00 00 02 00 00
					05 01 00 00 00 00 02 00 00
					23 01 00 00 00 00 02 d6 01
					29 01 00 00 00 00 08
						ce 00 01 88 c1 00
						1e 04
					29 01 00 00 00 00 21 ca
						00 80 80 80 80 80 80 80 08 20
						80 80 0a 4a 37 a0 55 f8 0c 0c
						20 10 3f 3f 00 00 10 10 3f 3f
						3f 3f
					39 01 00 00 00 00 02 53 2c						
					39 01 00 00 00 00 02 55 01
					39 01 00 00 00 00 02 29 00
					39 01 00 00 a0 00 02 11 00
					];
		qcom,mdss-dsi-on-enhance_cmd_i = [23 01 00 00 00 00 02 b0 04
					05 01 00 00 00 00 02 00 00
					05 01 00 00 00 00 02 00 00
					23 01 00 00 00 00 02 d6 01
					29 01 00 00 00 00 08
						ce 00 01 88 c1 00
						1e 04
					29 01 00 00 00 00 21 ca
						01 80 9c 9b 9b 40 be be 20 20
						80 fe 0a 4a 37 a0 55 f8 0c 0c
						20 10 3f 3f 00 00 10 10 3f 3f
						3f 3f
					39 01 00 00 00 00 02 53 2c						
					39 01 00 00 00 00 02 55 01
					39 01 00 00 00 00 02 29 00
					39 01 00 00 a0 00 02 11 00
					];
		qcom,mdss-dsi-on-enhance_cmd_n = [23 01 00 00 00 00 02 b0 04
					05 01 00 00 00 00 02 00 00
					05 01 00 00 00 00 02 00 00
					23 01 00 00 00 00 02 d6 01
					29 01 00 00 00 00 08
						ce 00 01 88 c1 00
						1e 04
					29 01 00 00 00 00 21 ca
						01 80 92 92 9b 75 9b 9b 20 20
						80 fe 0a 4a 37 a0 55 f8 0c 0c
						20 10 3f 3f 00 00 10 10 3f 3f
						3f 3f
					39 01 00 00 00 00 02 53 2c						
					39 01 00 00 00 00 02 55 01
					39 01 00 00 00 00 02 29 00
					39 01 00 00 a0 00 02 11 00
					];
		qcom,mdss-dsi-off-command = [39 01 00 00 20 00 02 28 00
				 39 01 00 00 78 00 02 10 00];
		qcom,mdss-dsi-on-command-state = "dsi_lp_mode";
		qcom,mdss-dsi-off-command-state = "dsi_hs_mode";
		qcom,mdss-dsi-h-sync-pulse = <0>;
		qcom,mdss-dsi-traffic-mode = "burst_mode";
		qcom,mdss-dsi-bllp-eof-power-mode;
		qcom,mdss-dsi-bllp-power-mode;
		qcom,mdss-dsi-lane-0-state;
		qcom,mdss-dsi-lane-1-state;
		qcom,mdss-dsi-lane-2-state;
		qcom,mdss-dsi-lane-3-state;
		qcom,mdss-dsi-panel-timings = [cf 41 38 00 5e 51 3a 43 59 03 04 00];
		qcom,mdss-dsi-t-clk-post = <0x04>;
		qcom,mdss-dsi-t-clk-pre = <0x1C>;
		qcom,mdss-dsi-bl-min-level = <1>;
		qcom,mdss-dsi-bl-max-level = <255>;
		qcom,mdss-dsi-bl-min-level_B = <3>;
		qcom,mdss-dsi-bl-max-level_B = <227>;
		mdss-dsi-hfp-power-mode;
		mdss-dsi-hsa-power-mode;
		mdss-dsi-hbp-power-mode;
		mdss-dsi-bllp-power-mode;
		mdss-dsi-bllp-eof-power-mode;
		qcom,mdss-dsi-dma-trigger = "trigger_sw";
		qcom,mdss-dsi-mdp-trigger = "none";
		qcom,mdss-dsi-bl-pmic-control-type = "bl_ctrl_unknown";
		qcom,mdss-dsi-bl-pmic-control-reg  = <0x51>;
		qcom,mdss-dsi-reset-sequence = <1 3>;
	};
};
