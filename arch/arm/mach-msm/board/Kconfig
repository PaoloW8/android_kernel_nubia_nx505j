## arch/arm/mach-msm/board/Kconfig
```kconfig
#
# Board configuration
#
menuconfig ARCH_MSM8974
	bool "Select the Supported Board of Nubia"
	help
	  Say Y here, and a list of supported Boards will be displayed.
	  This option doesn't affect the kernel.

	  If unsure, say Y.

if ARCH_MSM8974

config ARCH_MSM8974_ORIG
	bool "Original ARCH_MSM8974"
	help
	  Support for Qualcomm MSM8974AB/AC MTP original eval board.
	  
config ARCH_MSM8974_ZTEMT
	bool "ZTEMT ARCH_MSM8974"
	help
	  Support for ZTEMT MSM8974AB/AC MTP board.

choice
	depends on ARCH_MSM8974_ZTEMT
	prompt "MSM8974_MTP Based ZTEMT Board"
	
config BOARD_ZTEMT_NX601J
	bool "ZTEMT NX601J"
	help
	  Support for the ZTEMT NX601J board.

config BOARD_ZTEMT_NX504J
	bool "ZTEMT NX504J"
	help
	  Support for the ZTEMT NX504J board.

config BOARD_ZTEMT_NX505J
	bool "ZTEMT NX505J"
	help
	  Support for the ZTEMT NX505J board.

config BOARD_ZTEMT_NX506J
	bool "ZTEMT NX506J"
	help
	  Support for the ZTEMT NX506J board.

config BOARD_ZTEMT_NX507J
	bool "ZTEMT NX507J"
	help
	  Support for the ZTEMT NX507J board.	

config BOARD_ZTEMT_NX503A
	bool "ZTEMT NX503A"
	help
	  Support for the ZTEMT NX503A board.

config BOARD_ZTEMT_NX514J
	bool "ZTEMT NX514J"
	help
	  Support for the ZTEMT NX514J board.

config BOARD_ZTEMT_NX515J
	bool "ZTEMT NX515J"
	help
	  Support for the ZTEMT NX515J board.

config BOARD_ZTEMT_NX516J
	bool "ZTEMT NX516J"
	help
	  Support for the ZTEMT NX516J board.
endchoice	

config ZTEMT_RESTART
	bool "ZTEMT restart"
	help
	  Support for the ZTEMT restart

config ZTEMT_PANIC_BOOTMODE
	bool "Enable panic bootmode if kernel panic"
	help
	  Select this option will enable feature of setting a 'panic' flag into
          REBOOT_REASON_ADDR, thus the bootloader can detect the panic reboot reason
          and append a boomode to cmdline.

config EMMC_UNSUPPORTED_HPI
	bool "ZTEMT emmc unsupported hpi feature"
	help
	  emmc unsupported hpi feature.
endif
```

## drivers/input/touchscreen/atmel/Kconfig
```kconfig
#
# Synaptics DSX touchscreen driver configuration
#
menuconfig ZTEMT_TOUCHSCREEN_ATMEL_MXTS
	bool "ZTEMT ATMEL touchscreen"
	default n
	help
	  Say Y here if you have a Synaptics DSX touchscreen connected
	  to your system.

	  If unsure, say N.
	  
if ZTEMT_TOUCHSCREEN_ATMEL_MXTS

config TOUCHSCREEN_ATMEL_MXTS
	tristate "ATMEL Touthscreen"
	depends on ZTEMT_TOUCHSCREEN_ATMEL_MXTS
	default n

config TOUCHSCREEN_ATMEL_MXTS_DEBUG
	bool "Enable debug output"
	depends on TOUCHSCREEN_ATMEL_MXTS
	default n
	help
	  Enable Debug output for Cypress TrueTouch(tm)
	  Say Y here to enable debug output.

endif
```

## drivers/input/touchscreen/gt915/Kconfig
```kconfig
#
# Goodix GT9xx Touchscreen driver
#

menuconfig ZTEMT_TOUCHSCREEN_GT9XX
	bool "ZTEMT_TOUCHSCREEN_GT9XX"
	help
	  Say Y here, and a list of supported touchscreens will be displayed.
	  This option doesn't affect the kernel.

	  If unsure, say Y.

if ZTEMT_TOUCHSCREEN_GT9XX

choice
	prompt "Goodix TP IC Screen Size of the Module"
	
config ZTEMT_GT9XX_5P0_INCH_GW_720P
	bool "5.0 inch TP 720P"
	help
	  This option enables support Goodix inch TP 720P.

config ZTEMT_GT9XX_5P0_INCH_GW_1080P
	bool "5.0 inch TP 1080P"
	help
	  This option enables support Goodix inch TP 1080P.
endchoice

config ZTEMT_GT9XX_TOUCHSCREEN_DRIVER
	tristate "Goodix GT9xx touchpanel driver"
	depends on ZTEMT_TOUCHSCREEN_GT9XX
	default n
	help
	  This is the main file for touchpanel driver for Goodix GT9xx
	  touchscreens.

	  Say Y here if you have a Goodix GT9xx touchscreen connected
	  to your system.

	  If unsure, say N.

	  To compile this driver as a module, choose M here: the
	  module will be called gt9xx_update.

config ZTEMT_GT9XX_TOUCHSCREEN_UPDATE
	tristate "Goodix GT9xx touchpanel auto update support"
	depends on ZTEMT_GT9XX_TOUCHSCREEN_DRIVER
	default n
	help
	  This enables support for firmware update for Goodix GT9xx
	  touchscreens.

	  Say Y here if you have a Goodix GT9xx touchscreen connected
	  to your system.

	  If unsure, say N.

	  To compile this driver as a module, choose M here: the
	  module will be called gt9xx_update.

config ZTEMT_GT9XX_TOUCHSCREEN_DEBUG
	tristate "Goodix GT9xx Tools for debuging"
	depends on ZTEMT_GT9XX_TOUCHSCREEN_DRIVER
	default n
	help
	  This is application debug interface support for Goodix GT9xx
	  touchscreens.

	  Say Y here if you want to have a Android app debug interface
	  to your system.

	  If unsure, say N.

	  To compile this driver as a module, choose M here: the
	  module will be called gt9xx_update.

config ZTEMT_GT9XX_TOUCHSCREEN_TEST
       tristate "Goodix GT9xx Tools for testing"
       depends on ZTEMT_GT9XX_TOUCHSCREEN_DRIVER
       default n
       help
         This is application test interface support for Goodix GT9xx
         touchscreens.

         Say Y here if you want to have a Android app debug interface
         to your system.

         If unsure, say N.

         To compile this driver as a module, choose M here: the
         module will be called gt9xx_update.


endif
```

## drivers/input/touchscreen/synaptics_dsx/Kconfig
```kconfig
#
# Synaptics DSX touchscreen driver configuration
#
menuconfig ZTEMT_TOUCHSCREEN_SYNAPTICS_DSX
	bool "Synaptics DSX touchscreen"
	default n
	help
	  Say Y here if you have a Synaptics DSX touchscreen connected
	  to your system.

	  If unsure, say N.

if ZTEMT_TOUCHSCREEN_SYNAPTICS_DSX

choice
	prompt "Synaptics Touch Screen Size of the Module"
	
config ZTEMT_TOUCHSCREEN_SYNAPTICS_S3208
	bool "S3208 for NX503A NX505J NX40X NX403A"
	help
	  This option enables support 5.0 inch otg tp.

config ZTEMT_TOUCHSCREEN_SYNAPTICS_S3208_3keys
    bool "3 keys for NX505J"
    depends on ZTEMT_TOUCHSCREEN_SYNAPTICS_S3208
	
config ZTEMT_TOUCHSCREEN_SYNAPTICS_S3208_5keys
    bool "5 keys for NX503A NX40X NX403A"
    depends on ZTEMT_TOUCHSCREEN_SYNAPTICS_S3208

config ZTEMT_TOUCHSCREEN_SYNAPTICS_S3508
	bool "S3508 for NX504J NX506J"
	help
	  This option enables support 5.5 inch otg tp.
endchoice

choice
	default ZTEMT_TOUCHSCREEN_SYNAPTICS_DSX_I2C
	prompt "Synaptics DSX touchscreen bus interface"
config ZTEMT_TOUCHSCREEN_SYNAPTICS_DSX_I2C
	bool "I2C"
	depends on I2C
config ZTEMT_TOUCHSCREEN_SYNAPTICS_DSX_SPI
	bool "SPI"
	depends on SPI_MASTER
endchoice

config ZTEMT_TOUCHSCREEN_SYNAPTICS_DSX_CORE
	tristate "Synaptics DSX core driver module"
	depends on ZTEMT_TOUCHSCREEN_SYNAPTICS_DSX_I2C || ZTEMT_TOUCHSCREEN_SYNAPTICS_DSX_SPI
	help
	  Say Y here to enable basic touch reporting functionalities.

	  If unsure, say N.

	  To compile this driver as a module, choose M here: the
	  module will be called synaptics_dsx_core.

config ZTEMT_TOUCHSCREEN_SYNAPTICS_DSX_RMI_DEV
	tristate "Synaptics DSX touchscreen RMI device module"
	depends on ZTEMT_TOUCHSCREEN_SYNAPTICS_DSX_CORE
	help
	  Say Y here to enable support for direct RMI register access.

	  If unsure, say N.

	  To compile this driver as a module, choose M here: the
	  module will be called synaptics_dsx_rmi_dev.

config ZTEMT_TOUCHSCREEN_SYNAPTICS_DSX_FW_UPDATE
	tristate "Synaptics DSX touchscreen firmware update module"
	depends on ZTEMT_TOUCHSCREEN_SYNAPTICS_DSX_CORE
	help
	  Say Y here to enable support for carrying out firmware update.

	  If unsure, say N.

	  To compile this driver as a module, choose M here: the
	  module will be called synaptics_dsx_fw_update.

config ZTEMT_TOUCHSCREEN_SYNAPTICS_DSX_TEST_REPORTING
	tristate "Synaptics DSX touchscreen test reporting module"
	depends on ZTEMT_TOUCHSCREEN_SYNAPTICS_DSX_CORE
	help
	  Say Y here to enable support for retrieving self-test reports.

	  If unsure, say N.

	  To compile this driver as a module, choose M here: the
	  module will be called synaptics_dsx_test_reporting.

config ZTEMT_TOUCHSCREEN_SYNAPTICS_DSX_PROXIMITY
	tristate "Synaptics DSX touchscreen proximity module"
	depends on ZTEMT_TOUCHSCREEN_SYNAPTICS_DSX_CORE
	help
	  Say Y here to enable support for proximity functionalities.

	  If unsure, say N.

	  To compile this driver as a module, choose M here: the
	  module will be called synaptics_dsx_proximity.

config ZTEMT_TOUCHSCREEN_SYNAPTICS_DSX_DEBUG
	bool "Enable debug output"
	depends on ZTEMT_TOUCHSCREEN_SYNAPTICS_DSX_CORE
	default n

endif
```

## drivers/video/msm/mdss/Kconfig
```kconfig
config FB_MSM_MDSS_WRITEBACK
	bool "MDSS Writeback Panel"
	---help---
	The MDSS Writeback Panel provides support for routing the output of
	MDSS frame buffer driver and MDP processing to memory.

config FB_MSM_MDSS_HDMI_PANEL
	depends on FB_MSM_MDSS
	bool "MDSS HDMI Tx Panel"
	default n
	---help---
	The MDSS HDMI Panel provides support for transmitting TMDS signals of
	MDSS frame buffer data to connected hdmi compliant TVs, monitors etc.

config FB_MSM_MDSS_HDMI_MHL_SII8334
	depends on FB_MSM_MDSS_HDMI_PANEL
	bool 'MHL SII8334 support '
	default n
	---help---
	  Support the HDMI to MHL conversion.
	  MHL (Mobile High-Definition Link) technology
	  uses USB connector to output HDMI content

config FB_MSM_MDSS_DSI_CTRL_STATUS
	tristate "DSI controller status check feature"
	---help---
	  Check DSI controller status periodically (default period is 5
	  seconds) by sending Bus-Turn-Around (BTA) command. If DSI controller
	  fails to acknowledge the BTA command, it sends PANEL_ALIVE=0 status
	  to HAL layer to reset the controller.

config FB_MSM_MDSS_MDP3
	depends on FB_MSM_MDSS
	bool "MDP3 display controller"
	---help---
	The MDP3 provides support for an older version display controller
	included in latest display sub-system, known as MDSS.

#mayu 2012.12.19
menu "ZTEMT lcd driver support"
config ZTEMT_LCD_MIPI_COMMON
	bool "ztemt lcd MIPI interface driver module"
	default n
config ZTEMT_QCOMM_I2C6
       bool "qcomm i2c6"
       default n
       help
         qcomm i2c6
config ZTEMT_LCD_POWER_CONTRL
	bool "ztemt lcd AVDD IOVDD contrl"
	depends on ZTEMT_LCD_MIPI_COMMON
	default n
config LCD_KCAL
	depends on FB_MSM_MDSS
	bool "Enable sysfs for LCD KCAL"
	default n
#luochangyang 2014/03/07
choice
	prompt "MIPI 1080P R63311 SHARP IPS"
	depends on ZTEMT_LCD_MIPI_COMMON

config ZTEMT_MIPI_1080P_R63311_SHARP_IPS_5P0
	bool "MIPI 1080P R63311 SHARP IPS 5.0"
	help
	  This option enables support 5.0 inch LCD.

config ZTEMT_MIPI_1080P_R63311_SHARP_IPS_5P5
	bool "MIPI 1080P R63311 SHARP IPS 5.5"
	depends on ZTEMT_LCD_MIPI_COMMON
	help
	  This option enables support 5.54 inch LCD.
      
config ZTEMT_MIPI_1080P_R63417_SHARP_IPS_5P5
    bool "MIPI 1080P R63417 SHARP 5.5"
    help
        This option enables support 5.5 inch LCD.
	
config ZTEMT_MIPI_1080P_R63311_SHARP_IPS_6P4
	bool "MIPI 1080P R63311 SHARP IPS 6.4"
	help
	  This option enables support 6.4 inch LCD.
	  
config ZTEMT_MIPI_2K_R63419_SHARP_IPS_5P5
    bool "MIPI   2K  R63419 SHARP IPS 5.5"
    help
        This option enables support 5.5 inch LCD.
        
endchoice

choice
	prompt "MIPI 1080P R63311 SHARP IPS 5P0"
	depends on ZTEMT_MIPI_1080P_R63311_SHARP_IPS_5P0

config ZTEMT_MIPI_1080P_R63311_SHARP_IPS_5P0_NX503A
	bool "MIPI 1080P R63311 SHARP IPS 5.0 FOR NX503A"
	help
	  This option enables support 5.0 inch LCD for NX503A.

config ZTEMT_MIPI_1080P_R63311_SHARP_IPS_5P0_NX507J
	bool "MIPI 1080P R63311 SHARP IPS 5.0 FOR NX507J"
	help
	  This option enables support 5.0 inch LCD for NX507J.

endchoice

config ZTEMT_LCD_AVDD_CONFIG_BY_TPS65132
    bool "ztemt lcd AVDD config by tps65132"
	depends on ZTEMT_LCD_MIPI_COMMON
	default n
	
config ZTEMT_LCD_DISP_ENHANCE
	bool "LCD disp color enhance"
	depends on ZTEMT_LCD_MIPI_COMMON
	default n
	
config ZTEMT_LCD_DEBUG_EN
	bool "LCD debug log enable"
	depends on ZTEMT_LCD_MIPI_COMMON
	default n
#luochangyang END
config ZTEMT_LCD_BACKLIGHT
	bool "ztemt lcd backlight"
	depends on ZTEMT_LCD_MIPI_COMMON
	default n

config ZTEMT_LCD_BACKLIGHT_LINEAR_CONTROL_METHOLD
	bool "ztemt lcd backlight linear control methold"
	depends on ZTEMT_LCD_MIPI_COMMON
	default n

endmenu
```
